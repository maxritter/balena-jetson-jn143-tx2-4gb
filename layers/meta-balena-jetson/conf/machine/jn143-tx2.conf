## layers/meta-balena-jetson/conf/machine/jn143-tx2.conf
```bitbake
#@TYPE: Machine
##@NAME: jn143-tx2
##@DESCRIPTION: Machine configuration for the JN143

MACHINEOVERRIDES = "jetson-tx2:${MACHINE}"
include conf/machine/jetson-tx2-4gb.conf
```
